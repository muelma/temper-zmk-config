## boards/shields/temper/Kconfig.defconfig
```kconfig
if SHIELD_TEMPER_LEFT

config ZMK_KEYBOARD_NAME
    default "KacpersTemper"

config ZMK_SPLIT_ROLE_CENTRAL
    default y

endif

if SHIELD_TEMPER_LEFT || SHIELD_TEMPER_RIGHT

config ZMK_SPLIT
    default y

config ZMK_POINTING
    default y

config ZMK_SLEEP
    default y

config BT_CTLR_TX_PWR
    int
    default 8 

config ZMK_IDLE_SLEEP_TIMEOUT
    default 1800000

endif
```
